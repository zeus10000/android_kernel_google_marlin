// SPDX-License-Identifier: GPL-2.0-only
/dts-v1/;

#include "dm814x.dtsi"

/ {
	model = "DM8148 EVM";
	compatible = "ti,dm8148-evm", "ti,dm8148";

	memory {
		device_type = "memory";
		reg = <0x80000000 0x40000000>;	/* 1 GB */
	};
};

&cpsw_emac0 {
	phy_id = <&davinci_mdio>, <0>;
	phy-mode = "rgmii";
};

&cpsw_emac1 {
	phy_id = <&davinci_mdio>, <1>;
	phy-mode = "rgmii";
};
