## drivers/clk/tegra/Kconfig
```kconfig
# SPDX-License-Identifier: GPL-2.0-only
config TEGRA_CLK_EMC
	def_bool y
	depends on TEGRA124_EMC
```

## drivers/net/ethernet/apm/Kconfig
```kconfig
# SPDX-License-Identifier: GPL-2.0-only
source "drivers/net/ethernet/apm/xgene/Kconfig"
```

## drivers/reset/sti/Kconfig
```kconfig
# SPDX-License-Identifier: GPL-2.0-only
if ARCH_STI

config STI_RESET_SYSCFG
	bool
	select RESET_CONTROLLER

config STIH415_RESET
	bool
	select STI_RESET_SYSCFG

config STIH416_RESET
	bool
	select STI_RESET_SYSCFG

config STIH407_RESET
	bool
	select STI_RESET_SYSCFG

endif
```

## drivers/staging/qcacld-2.0/Kconfig
```kconfig
comment "Qualcomm Atheros CLD WLAN module"

config QCA_CLD_WLAN

	tristate "Qualcomm Atheros CLD WLAN module"
	default n
	help
	Add support for the Qualcomm Atheros CLD WLAN module

config WLAN_FEATURE_11W
	bool "Enable 802.11w Protected Management Frames (PMF)"
	depends on QCA_CLD_WLAN
	default y
	help
	  Enable 802.11w PMF support. Required for WPA3-SAE connections.
	  QCA6174A firmware supports PMF natively.

config WLAN_FEATURE_SAE
	bool "Enable WPA3-SAE (Simultaneous Authentication of Equals)"
	depends on QCA_CLD_WLAN
	default y
	help
	  Enable SAE authentication support for WPA3 connections.
	  Requires CFG80211_EXTERNAL_AUTH_SUPPORT in the cfg80211 stack.
```
